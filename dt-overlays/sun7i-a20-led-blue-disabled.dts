/*
* DevDotNet.ORG <anton@devdotnet.org>
*
* MIT License
* 
* Device: Integrated blue LED
*/

/dts-v1/;
/plugin/;

/ {
	compatible = "cubietech,cubietruck\0allwinner,sun7i-a20";
	
	fragment@0 {
		target-path = "/leds/";
		__overlay__ {
			blue {
				status = "disabled";
			};
		};
	};
};